## config/Kconfig.defconfig
```kconfig
# Copyright (c) 2020 Pete Johanson, Kurtis Lew
# SPDX-License-Identifier: MIT

if SHIELD_IRIS_LEFT

config ZMK_KEYBOARD_NAME
    default "Iris"

config ZMK_SPLIT_ROLE_CENTRAL
    default y

endif

if SHIELD_IRIS_LEFT || SHIELD_IRIS_RIGHT

config ZMK_SPLIT
    default y

endif


CONFIG_USB

CONFIG_ZMK_USB

CONFIG_USB_DEVICE_MANUFACTURER
    default "ZMK Project"
```
